## meta-custom-bsp/conf/layer.conf
```bitbake
# meta-custom-bsp - static BSP customizations for the ADSP-SC598 project.
#
# This is a hand-maintained layer (committed to the repo), as opposed to
# src/layers/meta-custom-apps which is GENERATED by `make apps` (bin/gen-apps.py).
# It is added to the build by bin/configure-build.sh via
# overlays/bblayers.conf.fragment (as ${BSPDIR}/../meta-custom-bsp).
#
# It carries:
#  - the Linux <-> SHARC+ DDR split: linux-adi + u-boot-adi bbappends that set the
#    DT /memory node + mem= and U-Boot CFG_SYS_SDRAM_* from LINUX_MEM (config.mk),
#    resolved into LINUX_MEM_BASE/LINUX_MEM_SIZE by bin/configure-build.sh.
#  - board-dns: a recipe that drops a systemd-resolved config setting DNS= from
#    BOARD_DNS (config.mk), so the board boots with a known resolver.
#  - LINUX_RT: the linux-adi bbappend adds a PREEMPT_RT config fragment (EXPERT +
#    CONFIG_PREEMPT_RT) when LINUX_RT=1 (config.mk), building the realtime kernel.

BBPATH .= ":${LAYERDIR}"
BBFILES += "${LAYERDIR}/recipes-*/*/*.bb ${LAYERDIR}/recipes-*/*/*.bbappend"

BBFILE_COLLECTIONS += "custom-bsp"
BBFILE_PATTERN_custom-bsp = "^${LAYERDIR}/"
# Higher than meta-custom-apps (10) so this layer's bbappends win on conflict.
BBFILE_PRIORITY_custom-bsp = "11"

LAYERSERIES_COMPAT_custom-bsp = "scarthgap"
# Depends on the ADI SC5xx layer (provides linux-adi) and OE core.
LAYERDEPENDS_custom-bsp = "core adsp-sc5xx"
```
